## boards/shields/viktus_slimini/Kconfig.defconfig
```kconfig
# Copyright (c) 2024 The ZMK Contributors
# SPDX-License-Identifier: MIT

if SHIELD_VIKTUS_SLIMINI

config ZMK_KEYBOARD_NAME
    default "Viktus Slimini"

endif
```

## boards/shields/viktus_slimini/Kconfig.shield
```kconfig
# Copyright (c) 2024 The ZMK Contributors
# SPDX-License-Identifier: MIT

config SHIELD_VIKTUS_SLIMINI
    def_bool $(shields_list_contains,viktus_slimini)
```
